## guest/pcie-vip/buildroot/Config.in
```kconfig
menu "PCIe VIP guest support"
source "$(BR2_EXTERNAL_PCIE_VIP_PATH)/package/pcie-vip/Config.in"
source "$(BR2_EXTERNAL_PCIE_VIP_PATH)/package/pcimem/Config.in"
endmenu
```

## guest/pcie-vip/buildroot/package/pcie-vip/Config.in
```kconfig
config BR2_PACKAGE_PCIE_VIP
	bool "pcie-vip guest tools"
	select BR2_PACKAGE_PCIUTILS
	help
	  Guest-side BAR utility and deterministic DMA/MSI-X test helper
	  for the standalone QEMU pcie-vip endpoint.
```

## guest/pcie-vip/buildroot/package/pcimem/Config.in
```kconfig
config BR2_PACKAGE_PCIMEM
	bool "pcimem userspace PCI BAR utility"
	help
	  Build billfarrow/pcimem for direct sysfs resource BAR access.
```
